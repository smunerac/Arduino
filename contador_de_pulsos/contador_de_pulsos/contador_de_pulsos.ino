/*

*/
#include <Wire.h>
#include <LCD.h>
#include <LiquidCrystal_I2C.h>
#define I2C_ADDR    0x27
#include <SoftwareSerial.h>
LiquidCrystal_I2C             lcd(I2C_ADDR,2, 1, 0, 4, 5, 6, 7);
#include "Print.h"
     
  const int pulsador = 9; // Entrada digital para el pulsador
  const int tiempoAntirrebote = 10; // tiempo en ms para evitar el rebote
  int cuenta = 0;
  int estadoBoton;
  int estadoBotonAnterior;
 
  // Función que evita el rebote del pulsador
  boolean antirrebote(int pin){
    int contador = 0;
    boolean estado;
    boolean estadoAnterior;   
    do {
      estado = digitalRead(pin);
      if(estado != estadoAnterior) {
        contador = 0;
        estadoAnterior = estado;}
      else {
        contador = contador+ 1;  }
      delay(1);
    } while(contador < tiempoAntirrebote);   
    return estado;
  }
   
       
  void setup()
  {
    Serial.begin(9600);  // Configura la velocidad de la comunicación serie
    lcd.begin(16,2);   // Inicializa el LCD para 16x2  
    lcd.backlight(); // LED de fondo encendido (backlight)
 
    pinMode(pulsador, INPUT); // PIN digital del pulsador como entrada
   
    // Presentamos datos por el LCD
    lcd.clear();
    lcd.setCursor(0,0);
    lcd.print("Pulsaciones: ");
  }
 
  void loop()
  {  
    estadoBoton = digitalRead(pulsador);
   
    if(estadoBoton != estadoBotonAnterior)
    {
      if(antirrebote(pulsador))
      {
        cuenta++;
        lcd.setCursor(13,0);
        lcd.print(cuenta);  // Se muestra a través del LCD el nº de veces que presionamos el pulsador
        Serial.println(cuenta);
      }
    }  
    estadoBotonAnterior = estadoBoton;
  }
