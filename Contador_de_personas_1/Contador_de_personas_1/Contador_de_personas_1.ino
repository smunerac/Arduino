/*
*/
#include <Wire.h>
#include <SoftwareSerial.h>
#include <Servo.h>              //Desabilita el PWM de los pines 9 y 10 en arduino UNO
Servo servo1;                   // crea los objetos para controlar los servomotores
Servo servo2;                   // crea los objetos para controlar los servomotores
const int pin_servo1=2;         //Pin de conexion de servo 1
const int pin_servo2=3;         //Pin de conexion de servo 2
const int pulsador_1 = 8; // Entrada digital para el pulsador
const int pulsador_2 = 9; // Entrada digital para el pulsador
const int tiempoAntirrebote = 10; // tiempo en ms para evitar el rebote
int cuenta = 0;
int estadoBoton_1;
int estadoBotonAnterior_1;
int estadoBoton_2;
int estadoBotonAnterior_2; 
const int valor_min_servo1=700;
const int valor_max_servo1=2600;
const int valor_min_servo2=700;
const int valor_max_servo2=2600;

void setup(){
Serial.begin(9600);  // Configura la velocidad de la comunicación serie
pinMode(pulsador_1, INPUT); // PIN digital del pulsador como entrada
pinMode(pulsador_2, INPUT); // PIN digital del pulsador como entrada
pinMode(pin_servo1,OUTPUT);  //declarar el pin como salida
pinMode(pin_servo2,OUTPUT);  //declarar el pin como salida
servo1.attach(pin_servo1, valor_min_servo1, valor_max_servo1); 
servo2.attach(pin_servo2, valor_min_servo2, valor_max_servo2);
servo1.write(90);
servo2.write(90);
}
 
  void loop(){  
    estadoBoton_1 = digitalRead(pulsador_1);
    estadoBoton_2 = digitalRead(pulsador_2); 
    if(estadoBoton_1 != estadoBotonAnterior_1){
      if(antirrebote1(pulsador_1)){
        cuenta++;
        if(cuenta<1){
        cuenta=0;}
        Serial.println(cuenta);
        servo1.write(130);
        delay(400);
        servo1.write(90);
      }
    }  
    estadoBotonAnterior_1 = estadoBoton_1;
    if(estadoBoton_2 != estadoBotonAnterior_2){
      if(antirrebote2(pulsador_2)){
        cuenta--;
        if(cuenta<1){
        cuenta=0;}
        Serial.println(cuenta);
        servo2.write(130);
        delay(400);
        servo2.write(90);
      }
    }  
    estadoBotonAnterior_2 = estadoBoton_2;




}














  // Función que evita el rebote del pulsador 1
  boolean antirrebote1(int pulsador_1){
    int contador = 0;
    boolean estado_1;
    boolean estadoAnterior_1;   
    do {
      estado_1 = digitalRead(pulsador_1);
      if(estado_1 != estadoAnterior_1) {
        contador = 0;
        estadoAnterior_1 = estado_1;}
      else {
        contador = contador+ 1;  }
      delay(1);
    } while(contador < tiempoAntirrebote);   
    return estado_1;
  }

  // Función que evita el rebote del pulsador 2
  boolean antirrebote2(int pulsador_2){
    int contador = 0;
    boolean estado_2;
    boolean estadoAnterior_2;   
    do {
      estado_2 = digitalRead(pulsador_2);
      if(estado_2 != estadoAnterior_2) {
        contador = 0;
        estadoAnterior_2 = estado_2;}
      else {
        contador = contador+ 1;  }
      delay(1);
    } while(contador < tiempoAntirrebote);   
    return estado_2;
  }
  
  
